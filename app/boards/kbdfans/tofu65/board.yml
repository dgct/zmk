## app/boards/kbdfans/tofu65/board.yml
```yaml
board:
  name: tofu65
  full_name: Tofu65
  vendor: kbdfans
  socs:
    - name: rp2040
      variants:
        - name: zmk
```

## app/boards/kinesis/adv360pro/board.yml
```yaml
boards:
- name: adv360pro_left
  vendor: kinesis
  socs:
  - name: nrf52840
    variants:
    - name: zmk
  full_name: Adv360Pro Left
- name: adv360pro_right
  vendor: kinesis
  socs:
  - name: nrf52840
    variants:
    - name: zmk
  full_name: Adv360Pro Right
```

## app/boards/mechwild/s40nc/board.yml
```yaml
board:
  name: s40nc
  full_name: S40Nc
  vendor: mechwild
  socs:
    - name: nrf52840
      variants:
        - name: zmk
```

## app/boards/moergo/glove80/board.yml
```yaml
boards:
- name: glove80_rh
  vendor: moergo
  socs:
  - name: nrf52840
  full_name: Glove80 Rh
- name: glove80_lh
  vendor: moergo
  socs:
  - name: nrf52840
  full_name: Glove80 Lh
```

## app/boards/nicekeyboards/nice60/board.yml
```yaml
board:
  name: nice60
  full_name: Nice60
  vendor: nicekeyboards
  socs:
    - name: nrf52840
      variants:
        - name: zmk
```

## app/boards/polarityworks/bt60/board.yml
```yaml
boards:
- name: bt60_hs
  vendor: polarityworks
  socs:
  - name: nrf52840
    variants:
    - name: zmk
  full_name: Bt60 Hs
- name: bt60
  vendor: polarityworks
  socs:
  - name: nrf52840
    variants:
    - name: zmk
  revision:
    format: major.minor.patch
    default: 2.0.0
    revisions:
    - name: 1.0.0
    - name: 2.0.0
  full_name: Bt60
```

## app/boards/polarityworks/bt65/board.yml
```yaml
board:
  name: bt65
  full_name: Bt65
  vendor: polarityworks
  socs:
    - name: nrf52840
      variants:
        - name: zmk
```

## app/boards/polarityworks/bt75/board.yml
```yaml
board:
  name: bt75
  full_name: Bt75
  vendor: polarityworks
  socs:
    - name: nrf52840
      variants:
        - name: zmk
```

## app/dts/bindings/zmk,ext-power-generic.yaml
```yaml
# Copyright (c) 2020 The ZMK Contributors
# SPDX-License-Identifier: MIT

description: |
  Generic driver for controlling the external power output
  by toggling the control-gpio pin status
  (Only in supported hardware)

compatible: "zmk,ext-power-generic"

properties:
  control-gpios:
    type: phandle-array
    required: true
  label:
    type: string
    required: false
    deprecated: true
  init-delay-ms:
    type: int
    description: Number of milliseconds to delay after initializing driver
    required: false
  init-off-delay-ms:
    type: int
    description: |
      Number of milliseconds to hold external power off during driver
      initialization before re-enabling. Useful for peripherals (e.g.
      trackpoints) with hardware power-on-reset circuits that need VCC
      to remain low long enough for the reset capacitor to discharge.
    required: false
```

## app/module/boards/jpconstantineau/bluemicro840/board.yml
```yaml
board:
  name: bluemicro840
  full_name: Bluemicro840
  vendor: jpconstantineau
  socs:
    - name: nrf52840
```

## app/module/boards/keycapsss/puchi_ble/board.yml
```yaml
board:
  name: puchi_ble
  full_name: Puchi Ble
  vendor: keycapsss
  socs:
    - name: nrf52840
```

## app/module/boards/makerdiary/nrf52840_m2/board.yml
```yaml
board:
  name: nrf52840_m2
  full_name: Nrf52840 M2
  vendor: makerdiary
  socs:
    - name: nrf52840
```

## app/module/drivers/Kconfig
```kconfig
# Copyright (c) 2020 The ZMK Contributors
# SPDX-License-Identifier: MIT

# Zephyr v4.4 removed the KSCAN subsystem. Define the symbol here so ZMK's
# kscan drivers continue to work.
config KSCAN
    bool "Keyboard Scan (kscan) drivers [ZMK]"

rsource "gpio/Kconfig"
rsource "kscan/Kconfig"
rsource "sensor/Kconfig"
rsource "display/Kconfig"
rsource "input/Kconfig"
```

## app/module/dts/bindings/kscan/kscan.yaml
```yaml
# Copyright (c) 2019, Intel Corporation
# SPDX-License-Identifier: Apache-2.0

# Common properties for keyboard matrix devices
# Re-added: removed from Zephyr in v4.4 (kscan→input migration)

include: base.yaml

bus: kscan
```

## app/src/pointing/Kconfig
```kconfig
# Copyright (c) 2024 The ZMK Contributors
# SPDX-License-Identifier: MIT

menu "Pointing Options"

# Deprecated old config, kept for backwards compat
config ZMK_MOUSE
    bool "(Deprecated) Mouse Support"

config ZMK_POINTING
    bool "Pointing Device Support"
    default y if ZMK_MOUSE
    select INPUT
    select INPUT_THREAD_PRIORITY_OVERRIDE

if ZMK_POINTING

# Needed for anyone using gpio-keys for things like soft-off setup.
config INPUT_GPIO_KEYS
    default n

config INPUT_THREAD_STACK_SIZE
    default 1024 if ZMK_SPLIT && !ZMK_SPLIT_ROLE_CENTRAL

if !ZMK_SPLIT || ZMK_SPLIT_ROLE_CENTRAL

config ZMK_POINTING_SMOOTH_SCROLLING
    bool "Smooth Scrolling"
    help
      Enable smooth scrolling, with hosts that support HID Resolution Multipliers

config ZMK_INPUT_LISTENER
    bool "Input listener for processing input events in the system"
    default y
    depends on DT_HAS_ZMK_INPUT_LISTENER_ENABLED


config ZMK_INPUT_PROCESSOR_TEMP_LAYER
    bool "Temporary Layer Input Processor"
    default y
    depends on DT_HAS_ZMK_INPUT_PROCESSOR_TEMP_LAYER_ENABLED

config ZMK_INPUT_PROCESSOR_TEMP_LAYER_MAX_ACTION_EVENTS
    int "Temporary Layer Input Processor Max Action Events"
    default 4
    depends on ZMK_INPUT_PROCESSOR_TEMP_LAYER

endif

config ZMK_INPUT_PROCESSOR_TRANSFORM
    bool "Transform Input Processor"
    default y
    depends on DT_HAS_ZMK_INPUT_PROCESSOR_TRANSFORM_ENABLED

config ZMK_INPUT_PROCESSOR_SCALER
    bool "Scaling Input Processor"
    default y
    depends on DT_HAS_ZMK_INPUT_PROCESSOR_SCALER_ENABLED

config ZMK_INPUT_PROCESSOR_CODE_MAPPER
    bool "Code Mapper Input Processor"
    default y
    depends on DT_HAS_ZMK_INPUT_PROCESSOR_CODE_MAPPER_ENABLED

config ZMK_INPUT_PROCESSOR_BEHAVIORS
    bool "Behaviors Input Processor"
    default y
    depends on DT_HAS_ZMK_INPUT_PROCESSOR_BEHAVIORS_ENABLED

config ZMK_INPUT_SPLIT
    bool "Split input support"
    default y
    depends on DT_HAS_ZMK_INPUT_SPLIT_ENABLED && ZMK_SPLIT

if ZMK_INPUT_SPLIT

config ZMK_INPUT_SPLIT_INIT_PRIORITY
    int "Input Split initialization priority"
    default INPUT_INIT_PRIORITY


config ZMK_INPUT_SPLIT_MAX_TRACKED_KEYS
    int "Input Split max tracked keys to release on peripheral disconnect"
    default 5

config ZMK_INPUT_SPLIT_FLUSH_MS
    int "Peripheral REL_X/REL_Y accumulator flush period (ms, 0=legacy)"
    default 40
    range 0 200
    help
      When > 0, accumulated REL_X/REL_Y motion on the peripheral side is
      flushed via a deferred work item every N ms instead of on every input
      sync. Reduces BLE GATT notification rate (and ATT TX buffer pressure)
      at the cost of up to N ms of added cursor latency. Default 40 ms ≈
      ~3 PS/2 samples per flush at 80 Hz, lowering notify rate from ~80/s
      to ~25/s. Set to 0 to restore legacy flush-on-every-sync behavior.

      Non-REL events (buttons, keys) trigger an immediate pre-flush so
      that motion arrives at the central before any subsequent click,
      preserving move-then-click ordering.

config ZMK_INPUT_SPLIT_MAX_IN_FLIGHT
    int "Max concurrent split-input notify operations"
    default 4
    range 1 8
    help
      How many bt_gatt_notify_cb calls may be in-flight (data handed to
      the BLE host stack, awaiting HCI Number-Of-Completed-Packets).
      Higher values decouple send rate from ~10 ms conn-event round-trip
      latency at the cost of holding more ATT TX pool buffers
      simultaneously. Should be <= CONFIG_BT_ATT_TX_COUNT / 2 so that
      position/sensor/SMP notifies are not starved. 1 restores legacy
      single-in-flight back-pressure (useful for bisecting regressions).

endif # ZMK_INPUT_SPLIT

endif # ZMK_POINTING

endmenu # Mouse Options
```

## app/west.yml
```yaml
manifest:
  remotes:
    - name: zephyrproject-rtos
      url-base: https://github.com/zephyrproject-rtos
    - name: zmkfirmware
      url-base: https://github.com/zmkfirmware
    - name: dgct
      url-base: https://github.com/dgct
  projects:
    - name: zephyr
      remote: dgct
      # v4.4.0 + ls0xx VCOM sem/SPI release fix (display freeze)
      # + [backport] BT_ATT_SENT_CB_AFTER_TX (true OTA-confirmed
      # ATT TX completion callback; opt-in via CONFIG_BT_ATT_SENT_CB_AFTER_TX=y).
      # + ls0xx blanking fallback demoted to LOG_DBG.
      # L2CAP drain fix dropped (upstream 27b56955 in v4.3.0).
      revision: daab7f98
      clone-depth: 1
      import:
        name-blocklist:
          - ci-tools
          - hal_altera
          - hal_cypress
          - hal_infineon
          - hal_microchip
          - hal_nxp
          - hal_openisa
          - hal_xtensa
          - hal_st
          - hal_ti
          - loramac-node
          - mcuboot
          - mcumgr
          - net-tools
          - openthread
          - edtt
          - trusted-firmware-m
    - name: hal_stm32
      revision: 4fcc3a3f32abe1c4cb76d9d1cef967728dd03908
      path: modules/hal/stm32
      remote: zmkfirmware
      groups:
        - hal
    - name: lvgl
      revision: f1db87ee98f1810328a8419572fa42a3b5f352ae
      path: modules/lib/gui/lvgl
      remote: zmkfirmware
    - name: zmk-studio-messages
      revision: 6cb4c283e76209d59c45fbcb218800cd19e9339d
      path: modules/msgs/zmk-studio-messages
      remote: zmkfirmware
  group-filter: [+optional]
  self:
    west-commands: scripts/west-commands.yml
```
