## app/src/split/bluetooth/Kconfig
```kconfig
# Copyright (c) 2022 The ZMK Contributors
# SPDX-License-Identifier: MIT

if ZMK_SPLIT && ZMK_SPLIT_BLE

menu "BLE Transport"

config ZMK_SPLIT_BLE_PRIORITY
    int "BLE transport priority"
    help
        Lower number priorities transports are favored over higher numbers.

# Added for backwards compatibility. New shields / board should set `ZMK_SPLIT_ROLE_CENTRAL` only.
config ZMK_SPLIT_BLE_ROLE_CENTRAL
    bool
    select ZMK_SPLIT_ROLE_CENTRAL

config ZMK_SPLIT_ROLE_CENTRAL
    select BT_CENTRAL
    select BT_GATT_CLIENT
    select BT_GATT_AUTO_DISCOVER_CCC
    select BT_SCAN_WITH_IDENTITY

# Bump this value needed for concurrent GATT discovery of splits
config BT_ATT_TX_COUNT
    default 10 if ZMK_SPLIT_ROLE_CENTRAL

if ZMK_SPLIT_ROLE_CENTRAL

config ZMK_SPLIT_BLE_CENTRAL_PERIPHERALS
    int "Number of peripherals that will connect to the central."

menuconfig ZMK_SPLIT_BLE_CENTRAL_BATTERY_LEVEL_FETCHING
    bool "Fetch Peripheral Battery Level Info"
    help
      Adds internal support for fetching the battery levels from peripherals
      and generating events in the ZMK eventing system.

if ZMK_SPLIT_BLE_CENTRAL_BATTERY_LEVEL_FETCHING

config ZMK_SPLIT_BLE_CENTRAL_BATTERY_LEVEL_QUEUE_SIZE
    int "Max number of battery level events to queue when received from peripherals"
    default ZMK_SPLIT_BLE_CENTRAL_PERIPHERALS

config ZMK_SPLIT_BLE_CENTRAL_BATTERY_LEVEL_PROXY
    bool "Proxy Peripheral Battery Level Info"
    help
      Adds support for reporting the battery levels of connected split
      peripherals through an additional Battery Level service.

config ZMK_SPLIT_BLE_CENTRAL_BATTERY_NOTIFY_DISCONNECT
    bool "Raise level=0 battery event on peripheral disconnect"
    default y
    help
      Default-on preserves legacy ZMK behavior: when a peripheral
      disconnects, the central fires a battery event with level=0 so
      widgets/host show the peripheral as offline. Set n to suppress
      the brief "0% then real value" flicker that hosts (e.g. macOS
      menu bar) show on every transient reconnect; the central re-reads
      the real value during service re-discovery within milliseconds
      anyway.

config ZMK_BATTERY_PROXY_NOTIFY_THROTTLE
    bool "Throttle peripheral battery proxy notifies"
    depends on ZMK_SPLIT_BLE_CENTRAL_BATTERY_LEVEL_PROXY
    help
      Suppress proxy battery notifies whose change since the last
      notify is below the hysteresis threshold AND whose elapsed time
      since the last notify is below the minimum interval. Notifies
      at or below the critical-level threshold always pass through.
      Mirrors PR #2938 (Genteure) hysteresis-and-min-interval pattern,
      scope-reduced to the proxy path.

config ZMK_BATTERY_PROXY_NOTIFY_HYSTERESIS_PCT
    int "Battery proxy notify hysteresis (percent)"
    depends on ZMK_BATTERY_PROXY_NOTIFY_THROTTLE
    range 1 20
    default 2
    help
      Minimum |delta_pct| required to send a non-critical proxy notify
      when the min-interval window has not elapsed.

config ZMK_BATTERY_PROXY_NOTIFY_MIN_INTERVAL_S
    int "Battery proxy notify minimum interval (seconds)"
    depends on ZMK_BATTERY_PROXY_NOTIFY_THROTTLE
    range 0 3600
    default 300
    help
      Minimum elapsed seconds between proxy notifies for the same
      source when the level change is below the hysteresis threshold.

config ZMK_BATTERY_PROXY_NOTIFY_CRITICAL_PCT
    int "Battery proxy critical-level threshold (percent)"
    depends on ZMK_BATTERY_PROXY_NOTIFY_THROTTLE
    range 0 50
    default 15
    help
      At or below this level, proxy notifies bypass the throttle so
      low-battery alerts reach the host promptly.

endif

config ZMK_SPLIT_BLE_CENTRAL_POSITION_QUEUE_SIZE
    int "Max number of key position state events to queue when received from peripherals"
    default 5

config ZMK_SPLIT_BLE_CENTRAL_SPLIT_RUN_QUEUE_SIZE
    int "Max number of behavior run events to queue to send to the peripheral(s)"
    default 5

config ZMK_SPLIT_BLE_PREF_INT
    int "Connection interval to use for split central/peripheral connection"
    default 6

config ZMK_SPLIT_BLE_PREF_LATENCY
    int "Latency to use for split central/peripheral connection"
    default 30

config ZMK_SPLIT_BLE_PREF_TIMEOUT
    int "Supervision timeout to use for split central/peripheral connection"
    default 400

config ZMK_SPLIT_BLE_IDLE_CONN_PARAMS
    bool "Widen split connection params during ZMK idle to save power"
    default y if ZMK_BLE_DYNAMIC_HID_LATENCY
    help
      When ZMK enters its idle state, widen the split central-peripheral
      link (CI, latency, timeout) to reduce radio wake-ups on both halves.
      Restored to fast params on first keypress. RMK validated pattern.

if ZMK_SPLIT_BLE_IDLE_CONN_PARAMS

config ZMK_SPLIT_BLE_IDLE_CI
    int "Split CI during ZMK idle (1.25ms units)"
    default 16
    help
      16 = 20ms. Combined with IDLE_LATENCY=200, gives ~4s effective
      wake cadence. RMK uses 20ms for connected-to-host idle.

config ZMK_SPLIT_BLE_IDLE_LATENCY
    int "Split slave latency during ZMK idle"
    default 200

config ZMK_SPLIT_BLE_IDLE_TIMEOUT
    int "Split supervision timeout during ZMK idle (10ms units)"
    default 900
    help
      900 = 9s. Must be > (1+latency)*CI*2 = (201*20ms*2) = 8040ms.

endif # ZMK_SPLIT_BLE_IDLE_CONN_PARAMS

menuconfig ZMK_BLE_QOS_OPENLL
    bool "BLE QoS adaptive channel-map filter (open-LL controller)"
    depends on BT_LL_SW_SPLIT
    select BT_CTLR_QOS_CRC_HOOK
    help
      Blob-free QoS channel-map filter for the Zephyr software split
      controller. Uses per-connection-event CRC statistics (via the
      controller hook BT_CTLR_QOS_CRC_HOOK) to rate the 37 BLE data
      channels and prune the worst ones through HCI LE Set Host Channel
      Classification. Central-only; rates the split central/peripheral
      link.

if ZMK_BLE_QOS_OPENLL

config ZMK_BLE_QOS_OPENLL_INTERVAL
    int "QoS processing interval (ms)"
    default 1000
    help
      Baseline period between channel-map evaluations when the link is
      clean. The interval drops to INTERVAL_FAST on CRC errors and
      doubles back toward this value each clean cycle.

config ZMK_BLE_QOS_OPENLL_INTERVAL_FAST
    int "QoS fast processing interval (ms)"
    default 100
    help
      Processing period used right after CRC errors or a wake burst,
      for rapid adaptation to new interference.

config ZMK_BLE_QOS_OPENLL_STACK_SIZE
    int "QoS thread stack size"
    default 768

config ZMK_BLE_QOS_OPENLL_MIN_CHANNEL_COUNT
    int "Minimum channels to keep in the map"
    default 15
    range 2 37
    help
      Never prune below this many channels regardless of scores. The
      BLE spec requires at least 2; 15 leaves comfortable headroom.

config ZMK_BLE_QOS_OPENLL_REINIT_ON_WAKE
    bool "Reset channel scores on wake from sleep"
    default y
    help
      On sleep->active the RF environment may have changed, so reset all
      channel scores to neutral and let them reconverge.

config ZMK_BLE_QOS_OPENLL_HOST_MAP_MERGE
    bool "Fold host/dongle channel map in as a soft penalty"
    default y
    help
      Read the channel map the host (or dongle) assigned to the
      peripheral-role link and penalize channels it avoids, blending its
      independent AFH assessment into the score. Soft, not a hard veto.

config ZMK_BLE_QOS_OPENLL_SCORE_W_CRC
    int "Score weight for CRC error ratio (Q8, 256=1.0)"
    default 1024

config ZMK_BLE_QOS_OPENLL_SCORE_W_HOST
    int "Score penalty for channels excluded by the host map"
    default 384

config ZMK_BLE_QOS_OPENLL_SCORE_BLOCK_THRESHOLD
    int "Score at/above which a channel is pruned (if above MIN count)"
    default 256

module = ZMK_BLE_QOS_OPENLL
module-str = ZMK BLE QoS (open-LL)
source "subsys/logging/Kconfig.template.log_config"

endif # ZMK_BLE_QOS_OPENLL

config ZMK_SPLIT_BLE_CENTRAL_SCAN_BACKOFF
    bool "Back off to a low-duty scan while a peripheral stays absent"
    help
      The stock passive scan for split peripherals (30 ms window every 60 ms)
      is a 50% receive duty for as long as a peripheral is missing, for
      example while the other half sleeps. Keep the stock parameters for
      ZMK_SPLIT_BLE_CENTRAL_SCAN_FAST_S seconds after every scan start, then
      scan ZMK_SPLIT_BLE_CENTRAL_SCAN_SLOW_WINDOW_MS out of every
      ZMK_SPLIT_BLE_CENTRAL_SCAN_SLOW_INTERVAL_MS. Pair with the peripheral's
      directed/fast advertising phases so a waking half is still found within
      a window or two.

if ZMK_SPLIT_BLE_CENTRAL_SCAN_BACKOFF

config ZMK_SPLIT_BLE_CENTRAL_SCAN_FAST_S
    int "Seconds of full-duty scanning after each scan start"
    default 60
    range 1 3600

config ZMK_SPLIT_BLE_CENTRAL_SCAN_SLOW_INTERVAL_MS
    int "Slow scan interval (ms)"
    default 250
    range 10 10240

config ZMK_SPLIT_BLE_CENTRAL_SCAN_SLOW_WINDOW_MS
    int "Slow scan window (ms)"
    default 30
    range 3 10240

endif # ZMK_SPLIT_BLE_CENTRAL_SCAN_BACKOFF

config ZMK_SPLIT_BLE_SCI
    bool "Shorter Connection Intervals on the split link (Core 6.2)"
    depends on BT_SHORTER_CONNECTION_INTERVALS
    help
      Once a split peripheral link is encrypted and on 2M PHY, negotiate the
      frame space and then ZMK_SPLIT_BLE_SCI_INTERVAL_US through the host's
      connection rate API. Driven by the frame_space_updated and
      conn_rate_changed callbacks; works on the open LL and the SoftDevice.
      The peripheral must be built with the same BT 6.x features.

if ZMK_SPLIT_BLE_SCI

config ZMK_SPLIT_BLE_SCI_INTERVAL_US
    int "Split link connection interval (us)"
    default 2000
    range 750 7500

config ZMK_SPLIT_BLE_SCI_SUPERVISION_TIMEOUT
    int "Supervision timeout at the short interval (10 ms units)"
    default 600
    range 10 3200

config ZMK_SPLIT_BLE_SCI_FSU
    bool "Negotiate the frame space before the interval"
    depends on BT_FRAME_SPACE_UPDATE
    default y
    help
      Ask for the smallest inter-frame space the controllers support on 2M
      PHY so more exchanges fit into the short connection event.

endif # ZMK_SPLIT_BLE_SCI

config ZMK_SPLIT_BLE_SUBRATING
    bool "Activity-driven connection subrating on the split link"
    depends on BT_SUBRATING
    help
      Three subrating tiers follow ZMK's activity state: ACTIVE while typing,
      IDLE after ZMK_BLE_SUBRATE_IDLE_DELAY of idle, DORMANT after
      ZMK_BLE_SUBRATE_DORMANT_DELAY or on sleep. Each tier is a standard LE
      Subrate Request confirmed through the subrate_changed callback; a tier is
      re-applied after a connection rate change, which resets the subrate. The
      peripheral needs only BT_SUBRATING.

if ZMK_SPLIT_BLE_SUBRATING


config ZMK_BLE_SUBRATE_ACTIVE_MIN
    int "Active subrate factor minimum"
    default 1
    range 1 500

config ZMK_BLE_SUBRATE_ACTIVE_MAX
    int "Active subrate factor maximum"
    default 2
    range 1 500

config ZMK_BLE_SUBRATE_ACTIVE_CN
    int "Active continuation number"
    default 1
    range 0 499


config ZMK_BLE_SUBRATE_TIMEOUT
    int "Supervision timeout (10ms units)"
    default 800
    range 10 3200

config ZMK_BLE_SUBRATE_ACTIVE_MAX_LATENCY
    int "Active maximum peripheral latency"
    default 4
    range 0 499

# IDLE tier
config ZMK_BLE_SUBRATE_IDLE_MIN
    int "Idle subrate factor minimum"
    default 1
    range 1 500

config ZMK_BLE_SUBRATE_IDLE_MAX
    int "Idle subrate factor maximum"
    default 15
    range 1 500

config ZMK_BLE_SUBRATE_IDLE_CN
    int "Idle continuation number"
    default 14
    range 0 499

config ZMK_BLE_SUBRATE_IDLE_MAX_LATENCY
    int "Idle maximum peripheral latency"
    default 2
    range 0 499

# IDLE tier entry delay
config ZMK_BLE_SUBRATE_IDLE_DELAY
    int "Milliseconds of ZMK idle before the IDLE tier"
    default 30000
    range 0 3600000
    help
      The split link leaves the ACTIVE tier for the IDLE tier this many
      milliseconds after ZMK reports the idle activity state. ZMK's own
      idle timeout (ZMK_IDLE_TIMEOUT) is often set short for display or
      trackpad power management; this delay keeps the split link at full
      rate across ordinary typing pauses, so the first key after a pause
      is not held for a subrated interval. 0 enters IDLE immediately.

# DORMANT tier
config ZMK_BLE_SUBRATE_DORMANT_DELAY
    int "Milliseconds before dormant tier"
    default 900000
    range 10000 3600000

config ZMK_BLE_SUBRATE_DORMANT_MIN
    int "Dormant subrate factor minimum"
    default 1
    range 1 500

config ZMK_BLE_SUBRATE_DORMANT_MAX
    int "Dormant subrate factor maximum"
    default 80
    range 1 500

config ZMK_BLE_SUBRATE_DORMANT_CN
    int "Dormant continuation number"
    default 20
    range 0 499

config ZMK_BLE_SUBRATE_DORMANT_MAX_LATENCY
    int "Dormant maximum peripheral latency"
    default 0
    range 0 499


endif # ZMK_SPLIT_BLE_SUBRATING

endif # ZMK_SPLIT_ROLE_CENTRAL

if !ZMK_SPLIT_ROLE_CENTRAL

config ZMK_SPLIT_BLE_PERIPHERAL_POSITION_QUEUE_SIZE
    int "Max number of key position state events to queue to send to the central"
    default 10

config BT_FILTER_ACCEPT_LIST
    default y

config BT_MAX_PAIRED
    default 1

config BT_MAX_CONN
    default 1

# Allow central to specify connection parameters.
config BT_GAP_AUTO_UPDATE_CONN_PARAMS
    default n

config ZMK_SPLIT_BLE_PERIPHERAL_ADV_DIRECTED
    bool "Start with high-duty directed advertising to the bonded central"
    help
      After boot, wake or a disconnect, advertise directed at the bonded
      central for the 1.28 s the controller allows (3.75 ms events), then
      fall back to undirected advertising with the filter accept list. A
      scanning central connects within its first scan window instead of
      after several 100-150 ms advertising events.

config ZMK_SPLIT_BLE_PERIPHERAL_ADV_FAST_S
    int "Seconds of fast (30-60 ms) undirected advertising before the stock 100-150 ms"
    default 0
    range 0 3600
    help
      0 keeps the stock 100-150 ms interval from the start.

endif # !ZMK_SPLIT_ROLE_CENTRAL

endmenu

endif # ZMK_SPLIT_BLE
```
